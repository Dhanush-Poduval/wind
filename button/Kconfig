## button/Kconfig
```kconfig
config CUSTOM_BUTTON
	bool "Custom button"
	default n
	depends on GPIO
	help
	  Enable the custom button driver
```

## say_hello/Kconfig
```kconfig
#create say hello

config SAY_HELLO
	bool "Basic Print test"
	default n
	depends on PRINTK
	help
	   Adds th say_hello() function
```
